/*
 * Copyright (c) 2022 The ZMK Contributors
 *
 * SPDX-License-Identifier: MIT
 */

#include <behaviors.dtsi>
#include <dt-bindings/zmk/keys.h>

/ {
    keymap {
        compatible = "zmk,keymap";

        default_layer {
            display-name = "base";
            bindings = <
                &kp B   
                &kp C 
                &kp D  
                &kp E   
                &kp F   
                &kp G   
                &kp H    
                &kp I   
                &kp J   
                &kp K    

            >;
        };
    };
};